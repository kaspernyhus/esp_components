## esp_signal_generator/Kconfig
```kconfig
menu "ESP Signal Generator"
    config ENABLE_ESP_SIGNAL_GENERATOR
        bool "Use ESP Signal Generator"
        default n
        help
            Enable esp_signal_generator component

    if ENABLE_ESP_SIGNAL_GENERATOR
        config ESP_SIG_GEN_DEF_SAMPLE_RATE
            int "Sample rate"
            range 1 96000
            default 48000
            help
                Default sample rate [1 - 96000]

        config ESP_SIG_GEN_CHANNELS
            int "Channels"
            range 1 4
            default 1
            help
                Default number of channels

        config ESP_SIG_GEN_DEF_VOLUME
            int "Volume"
            range 0 100
            default 80
            help
                Default volume [0-100]

        choice ESP_SIG_GEN_DEF_WAVE
            prompt  "Waveform"
            default ESP_SIG_GEN_SINE
            help
                Default waveform
            config ESP_SIG_GEN_SINE
                bool "Sine"
            config ESP_SIG_GEN_SINE_TAB
                bool "Sine (lookup table)"
            config ESP_SIG_GEN_PINK_NOISE
                bool "Pink noise"
            config ESP_SIG_GEN_SILENCE
                bool "Silence"
        endchoice

        config ESP_SIG_GEN_DEF_FREQ
            depends on ESP_SIG_GEN_SINE || ESP_SIG_GEN_SINE_TAB
            int "Frequency"
            range 1 20000
            default 440
            help
                Default frequency

        config ESP_SIG_GEN_DEF_FREQ_CH2
            depends on ESP_SIG_GEN_CHANNELS = 2
            int "Frequency CH2"
            range 1 20000
            default 440
            help
                Default frequency for channel 2

        choice ESP_SIG_GEN_DEF_BITDEPTH
            prompt  "Bitdepth"
            default ESP_SIG_GEN_16
            help
                Default sample bitdepth
            config ESP_SIG_GEN_16
                bool "16bit"
            config ESP_SIG_GEN_24
                bool "24bit (32bit width)"
            config ESP_SIG_GEN_24_3
                bool "24bit (packed)"
            config ESP_SIG_GEN_32
                bool "32bit"
        endchoice

        choice ESP_SIG_GEN_DEF_PADDING
            depends on ESP_SIG_GEN_24
            prompt "Padding"
            default ESP_SIG_GEN_PADDING_MSB
            help
                For 24/32 padding byte LSB (0x------00) or MSB (0x00------)
            config ESP_SIG_GEN_PADDING_MSB
                bool "MSB"
            config ESP_SIG_GEN_PADDING_LSB
                bool "LSB"
        endchoice

        config ESP_SIG_GEN_SIGN_EXT
            depends on ESP_SIG_GEN_24
            bool "Sign extension"
            default n
            help
                Enable sign extension (otherwise zero extended)

        choice ESP_SIG_GEN_DEF_ENDIANESS
            prompt  "Endianess"
            default ESP_SIG_GEN_LE
            help
                Default sample endianess
            config ESP_SIG_GEN_LE
                bool "LE"
            config ESP_SIG_GEN_BE
                bool "BE"
        endchoice

        choice ESP_SIG_GEN_DEF_LAYOUT
            prompt  "Channel layout"
            default ESP_SIG_GEN_INTERLEAVED
            help
                Default layout
            config ESP_SIG_GEN_INTERLEAVED
                bool "Interleaved"
            config ESP_SIG_GEN_NON_INTERLEAVED
                bool "Non-Interleaved"
        endchoice

        choice ESP_SIG_GEN_DEF_METHOD
            prompt  "Generation method"
            default ESP_SIG_GEN_PULL
            help
                Default method
            config ESP_SIG_GEN_PULL
                bool "Pull"
            config ESP_SIG_GEN_PUSH
                bool "Push"
        endchoice

        config ESP_SIG_GEN_PUSH_INTERVAL
            depends on ESP_SIG_GEN_PUSH
            int "Push interval [ms]"
            default 5
            help
                Default push interval in ms

    endif # ESP_SIGNAL_GENERATOR
endmenu # "TinyUSB Stack"
```

## esp_wifi_manager/Kconfig
```kconfig
menu "Wi-Fi Manager"

    choice WIFI_MGR_PROVISIONING_METHOD
        depends on !ESP_DISABLE_WIFI
        prompt "Provisioning method"
        default WIFI_MGR_KCONFIG_CREDENTIALS
        help
            Select provisioning or enter ssid and password here
        config WIFI_MGR_ESP_PROV
            bool "Espressif Provisioning"
        config WIFI_MGR_CUSTOM_PROV
            bool "Custom Provisioning"
        config WIFI_MGR_KCONFIG_CREDENTIALS
            bool "Hardcoded credentials"
    endchoice

    config WIFI_MGR_ESP_PROV_SERVICE_NAME
        depends on WIFI_MGR_ESP_PROV
        string "Service Name"
        default "espressif"
        help
            Service name

    config WIFI_MGR_PROV_MAX_TIME
        depends on WIFI_MGR_ESP_PROV || WIFI_MGR_CUSTOM_PROV
        int "Provision mode timeout [minutes]"
        default 15
        help
            Max time in active provision mode [minutes] before timeout

    config WIFI_MGR_ESP_WIFI_SSID
        depends on WIFI_MGR_KCONFIG_CREDENTIALS
        string "WiFi SSID"
        default "myssid"
        help
            SSID (network name) for the example to connect to.

    config WIFI_MGR_ESP_WIFI_PASSWORD
        depends on WIFI_MGR_KCONFIG_CREDENTIALS
        string "WiFi Password"
        default "mypassword"
        help
            WiFi password (WPA or WPA2) for the example to use.

    choice WIFI_MGR_SCAN_AUTH_MODE_THRESHOLD
        depends on WIFI_MGR_KCONFIG_CREDENTIALS
        prompt "WiFi Scan auth mode threshold"
        default ESP_WIFI_AUTH_OPEN
        help
            The weakest authmode to accept in the scan mode.

        config ESP_WIFI_AUTH_OPEN
            bool "OPEN"
        config ESP_WIFI_AUTH_WEP
            bool "WEP"
        config ESP_WIFI_AUTH_WPA_PSK
            bool "WPA PSK"
        config ESP_WIFI_AUTH_WPA2_PSK
            bool "WPA2 PSK"
        config ESP_WIFI_AUTH_WPA_WPA2_PSK
            bool "WPA/WPA2 PSK"
        config ESP_WIFI_AUTH_WPA3_PSK
            bool "WPA3 PSK"
        config ESP_WIFI_AUTH_WPA2_WPA3_PSK
            bool "WPA2/WPA3 PSK"
        config ESP_WIFI_AUTH_WAPI_PSK
            bool "WAPI PSK"
    endchoice

    config WIFI_MGR_FORCE_CREDENTIALS
        depends on WIFI_MGR_KCONFIG_CREDENTIALS
        bool "Force new credentials"
        default false
        help
            Force these credentials on every boot

    config WIFI_MGR_ESP_MAXIMUM_RETRY
        int "Maximum retry"
        default 5
        help
            Set the Maximum retry to avoid station reconnecting to the AP unlimited when the AP is really inexistent.

endmenu
```
